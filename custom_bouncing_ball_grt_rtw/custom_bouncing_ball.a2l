/******************************************************************************
* ASAP2 file: custom_bouncing_ball.a2l
* Code generation for model "custom_bouncing_ball".
* Model version : 1.4
* Simulink Coder version : 10.4 R2021b
* C source code generated on : Tue May 17 16:34:50 2022
* Target selection: grt.tlc
* Embedded hardware selection: MATLAB Host
* Code generation objectives: Unspecified
* Validation result: Not run
* (add additional file header information here)
******************************************************************************/ ASAP2_VERSION 1 71
/* Version 1.71 */
/begin PROJECT ProjectName "Project Comment Goes Here"
/begin HEADER "Header Comments go here" /end HEADER
/begin MODULE ModuleName "Module Comment Goes Here"
/begin MOD_PAR "MOD PAR Comment Goes Here" /end MOD_PAR
/begin MOD_COMMON "Mod Common Comment Here" BYTE_ORDER MSB_LAST ALIGNMENT_BYTE 1 ALIGNMENT_WORD 2 ALIGNMENT_LONG 4 ALIGNMENT_FLOAT32_IEEE 4 ALIGNMENT_FLOAT64_IEEE 8 ALIGNMENT_INT64 8 /end MOD_COMMON
/begin CHARACTERISTIC custom_bouncing_ball_P.IntegratorSecondOrder_ICX "" VALUE 0x0000 /* @ECU_Address@custom_bouncing_ball_P.IntegratorSecondOrder_ICX@ */ Scalar_FLOAT64_IEEE 0 custom_bouncing_ball_CM_double -1.7E+308 1.7E+308 /end CHARACTERISTIC
/begin CHARACTERISTIC custom_bouncing_ball_P.Memory_InitialCondition "" VALUE 0x0000 /* @ECU_Address@custom_bouncing_ball_P.Memory_InitialCondition@ */ Scalar_FLOAT64_IEEE 0 custom_bouncing_ball_CM_double -1.7E+308 1.7E+308 /end CHARACTERISTIC
/begin CHARACTERISTIC custom_bouncing_ball_P.g "" VALUE 0x0000 /* @ECU_Address@custom_bouncing_ball_P.g@ */ Scalar_FLOAT64_IEEE 0 custom_bouncing_ball_CM_double -1.7E+308 1.7E+308 /end CHARACTERISTIC
/begin CHARACTERISTIC custom_bouncing_ball_P.r "" VALUE 0x0000 /* @ECU_Address@custom_bouncing_ball_P.r@ */ Scalar_FLOAT64_IEEE 0 custom_bouncing_ball_CM_double -1.7E+308 1.7E+308 /end CHARACTERISTIC
/begin CHARACTERISTIC custom_bouncing_ball_P.v "" VALUE 0x0000 /* @ECU_Address@custom_bouncing_ball_P.v@ */ Scalar_FLOAT64_IEEE 0 custom_bouncing_ball_CM_double -1.7E+308 1.7E+308 /end CHARACTERISTIC
/begin MEASUREMENT custom_bouncing_ball_B.InitialVelocity "" FLOAT64_IEEE custom_bouncing_ball_CM_double 0 0 -1.7E+308 1.7E+308 ECU_ADDRESS 0x0000 /* @ECU_Address@custom_bouncing_ball_B.InitialVelocity@ */ /end MEASUREMENT
/begin MEASUREMENT custom_bouncing_ball_B.IntegratorSecondOrder_o2 "" FLOAT64_IEEE custom_bouncing_ball_CM_double 0 0 -1.7E+308 1.7E+308 ECU_ADDRESS 0x0000 /* @ECU_Address@custom_bouncing_ball_B.IntegratorSecondOrder_o2@ */ /end MEASUREMENT
/begin MEASUREMENT custom_bouncing_ball_DW.InitialVelocity_FirstOutputTime "" UBYTE custom_bouncing_ball_CM_logical 0 0 0 1 ECU_ADDRESS 0x0000 /* @ECU_Address@custom_bouncing_ball_DW.InitialVelocity_FirstOutputTime@ */ /end MEASUREMENT
/begin MEASUREMENT custom_bouncing_ball_DW.IntegratorSecondOrder_DWORK1 "" UBYTE custom_bouncing_ball_CM_logical 0 0 0 1 ECU_ADDRESS 0x0000 /* @ECU_Address@custom_bouncing_ball_DW.IntegratorSecondOrder_DWORK1@ */ /end MEASUREMENT
/begin MEASUREMENT custom_bouncing_ball_DW.IntegratorSecondOrder_MODE "" SLONG custom_bouncing_ball_CM_int_T 0 0 -2147483648 2147483647 ECU_ADDRESS 0x0000 /* @ECU_Address@custom_bouncing_ball_DW.IntegratorSecondOrder_MODE@ */ /end MEASUREMENT
/begin MEASUREMENT custom_bouncing_ball_DW.Memory_PreviousInput "" FLOAT64_IEEE custom_bouncing_ball_CM_double 0 0 -1.7E+308 1.7E+308 ECU_ADDRESS 0x0000 /* @ECU_Address@custom_bouncing_ball_DW.Memory_PreviousInput@ */ /end MEASUREMENT
/begin MEASUREMENT custom_bouncing_ball_Y.Position "" FLOAT64_IEEE custom_bouncing_ball_CM_double 0 0 -1.7E+308 1.7E+308 ECU_ADDRESS 0x0000 /* @ECU_Address@custom_bouncing_ball_Y.Position@ */ /end MEASUREMENT
/begin MEASUREMENT custom_bouncing_ball_Y.Velocity "" FLOAT64_IEEE custom_bouncing_ball_CM_double 0 0 -1.7E+308 1.7E+308 ECU_ADDRESS 0x0000 /* @ECU_Address@custom_bouncing_ball_Y.Velocity@ */ /end MEASUREMENT
/begin COMPU_METHOD custom_bouncing_ball_CM_double "Q = V" IDENTICAL "%15.10" "" /end COMPU_METHOD
/begin COMPU_METHOD custom_bouncing_ball_CM_int_T "Q = V" IDENTICAL "customformat" "" /end COMPU_METHOD
/begin COMPU_METHOD custom_bouncing_ball_CM_logical "Q = V" IDENTICAL "%1.0" "" /end COMPU_METHOD
/begin RECORD_LAYOUT Scalar_BOOLEAN FNC_VALUES 1 UBYTE COLUMN_DIR DIRECT /end RECORD_LAYOUT
/begin RECORD_LAYOUT Scalar_FLOAT64_IEEE FNC_VALUES 1 FLOAT64_IEEE COLUMN_DIR DIRECT /end RECORD_LAYOUT
/begin RECORD_LAYOUT Scalar_SLONG FNC_VALUES 1 SLONG COLUMN_DIR DIRECT /end RECORD_LAYOUT
/begin GROUP custom_bouncing_ball "custom_bouncing_ball" /* Root */ ROOT
 /begin REF_CHARACTERISTIC custom_bouncing_ball_P.IntegratorSecondOrder_ICX custom_bouncing_ball_P.Memory_InitialCondition custom_bouncing_ball_P.g custom_bouncing_ball_P.r custom_bouncing_ball_P.v /end REF_CHARACTERISTIC
 /begin REF_MEASUREMENT custom_bouncing_ball_B.InitialVelocity custom_bouncing_ball_B.IntegratorSecondOrder_o2 custom_bouncing_ball_DW.InitialVelocity_FirstOutputTime custom_bouncing_ball_DW.IntegratorSecondOrder_DWORK1 custom_bouncing_ball_DW.IntegratorSecondOrder_MODE custom_bouncing_ball_DW.Memory_PreviousInput custom_bouncing_ball_Y.Position custom_bouncing_ball_Y.Velocity /end REF_MEASUREMENT
/end GROUP
/end MODULE
/end PROJECT
/* (add any file trailer comments here) */
/* EOF custom_bouncing_ball.a2l*/
